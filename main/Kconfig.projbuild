## main/Kconfig.projbuild
```kconfig
menu "Example Configuration"

config ROUTER_SSID
    string "Router SSID"
        default "blinker"
        help
            Router SSID.

config ROUTER_PASSWORD
    string "Router password"
        default "12345678"
        help
            Router password.

config SERVER_IP
    string "Server IP address"
        default "192.168.5.1"
        help
            Server IP address.

config SERVER_PORT
    int "Server port"
        default "8080"
        help
            Server port.

endmenu
```
